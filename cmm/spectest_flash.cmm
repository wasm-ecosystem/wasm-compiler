
LOCAL &elfFile
&elfFile="~~~~/../build_tasking/bin/vb_spectest_binary_standalone.elf"

DO ~~~~/flash_elf_file.cmm "&elfFile"
